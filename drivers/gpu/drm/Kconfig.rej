## lib/Kconfig.debug.rej
```kconfig
--- lib/Kconfig.debug
+++ lib/Kconfig.debug
@@ -1774,7 +1774,6 @@
 config INTERVAL_TREE_TEST
 	tristate "Interval tree test"
 	depends on m && DEBUG_KERNEL
-	select INTERVAL_TREE
 	help
 	  A benchmark measuring the performance of the interval tree library
 
```

## lib/Kconfig.rej
```kconfig
--- lib/Kconfig
+++ lib/Kconfig
@@ -347,20 +347,6 @@
 config BTREE
 	bool
 
-config INTERVAL_TREE
-	bool
-	help
-	  Simple, embeddable, interval-tree. Can find the start of an
-	  overlapping range in log(n) time and then iterate over all
-	  overlapping nodes. The algorithm is implemented as an
-	  augmented rbtree.
-
-	  See:
-
-		Documentation/rbtree.txt
-
-	  for more information.
-
 config RADIX_TREE_MULTIORDER
 	bool
 
```
